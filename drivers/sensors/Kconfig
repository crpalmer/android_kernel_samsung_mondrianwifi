## drivers/sensors/Kconfig
```kconfig
config SENSORS
	bool "Sensors Class Support"
	help
	  This option enables the sensor sysfs class in /sys/class/sensors.
	  You'll need this to do anything useful with sensorss. If unsure, say N.

config SENSORS_GP2A030A
	depends on I2C
	tristate "GP2A030A Light Driver"
	default n
	help
	  Say Y here if you use GP2A030A.
	  This option enables optial sensors using
	  Sharp GP2A030A device driver.

	  Say N here if you do not use GP2A030A.

config SENSORS_GP2A030A_PROX
	depends on SENSORS_GP2A030A
	tristate "GP2A030A Proximity Driver"
	default n
	help
	  Say Y here if you use GP2A030A.
	  This option enables optial sensors using
	  Sharp GP2A030A device driver.

	  Say N here if you do not use GP2A030A.

config SENSORS_SX9500
	depends on I2C
	tristate "SX9500 driver"
	default n
	help
	  Say Y here if you use sx9500.
	  This option enables grip sensors using
	  SemTech sx9500 device driver.

	  Say N here if you do not use sx9500.

config SENSORS_SX9500_INIT_TOUCH_THRESHOLD
	int "SX9500 Grip sensor threshold for init touch"
	depends on SENSORS_SX9500
	default "3000"
	help
	  This value is the standard of init touch using
	  SemTech sx9500 device driver.

config SENSORS_SX9500_NORMAL_TOUCH_THRESHOLD
	int "SX9500 Grip sensor threshold for normal touch"
	depends on SENSORS_SX9500
	default "17"
	help
	  This value is the standard of normal touch using
	  SemTech sx9500 device driver.
```
